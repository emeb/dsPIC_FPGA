; Fsamp = 44982
; Fmin_scale = 0xd983010
; Fmin_scale = 228077609
.equ ADC_cal, 0xa3d7
powtab:
.pword 0x54821d, 0x54bcc5, 0x54f796, 0x553290, 0x556db2, 0x55a8fd, 0x55e472, 0x562010
.pword 0x565bd7, 0x5697c7, 0x56d3e2, 0x571026, 0x574c94, 0x57892c, 0x57c5ee, 0x5802da
.pword 0x583ff0, 0x587d31, 0x58ba9c, 0x58f832, 0x5935f3, 0x5973de, 0x59b1f4, 0x59f036
.pword 0x5a2ea3, 0x5a6d3b, 0x5aabff, 0x5aeaee, 0x5b2a08, 0x5b6950, 0x5ba8c2, 0x5be861
.pword 0x5c282b, 0x5c6822, 0x5ca846, 0x5ce896, 0x5d2912, 0x5d69bc, 0x5daa92, 0x5deb95
.pword 0x5e2cc5, 0x5e6e23, 0x5eafae, 0x5ef166, 0x5f334c, 0x5f7560, 0x5fb7a2, 0x5ffa11
.pword 0x603caf, 0x607f7b, 0x60c275, 0x61059e, 0x6148f5, 0x618c7c, 0x61d031, 0x621415
.pword 0x625828, 0x629c6a, 0x62e0dd, 0x63257e, 0x636a4e, 0x63af4f, 0x63f480, 0x6439e0
.pword 0x647f71, 0x64c532, 0x650b24, 0x655146, 0x659799, 0x65de1c, 0x6624d1, 0x666bb6
.pword 0x66b2cd, 0x66fa15, 0x67418e, 0x67893a, 0x67d117, 0x681925, 0x686166, 0x68a9d9
.pword 0x68f27e, 0x693b56, 0x698460, 0x69cd9d, 0x6a170d, 0x6a60b0, 0x6aaa86, 0x6af48f
.pword 0x6b3ecb, 0x6b893b, 0x6bd3de, 0x6c1eb6, 0x6c69c2, 0x6cb501, 0x6d0075, 0x6d4c1d
.pword 0x6d97fa, 0x6de40b, 0x6e3051, 0x6e7ccc, 0x6ec97c, 0x6f1661, 0x6f637c, 0x6fb0cc
.pword 0x6ffe52, 0x704c0e, 0x7099ff, 0x70e827, 0x713685, 0x71851a, 0x71d3e5, 0x7222e6
.pword 0x72721e, 0x72c18e, 0x731134, 0x736113, 0x73b128, 0x740174, 0x7451f9, 0x74a2b5
.pword 0x74f3aa, 0x7544d7, 0x75963c, 0x75e7d9, 0x7639af, 0x768bbe, 0x76de07, 0x773088
.pword 0x778342, 0x77d636, 0x782963, 0x787cca, 0x78d06b, 0x792446, 0x79785b, 0x79ccab
.pword 0x7a2135, 0x7a75f9, 0x7acaf9, 0x7b2034, 0x7b75aa, 0x7bcb5b, 0x7c2147, 0x7c776f
.pword 0x7ccdd3, 0x7d2473, 0x7d7b4f, 0x7dd268, 0x7e29bd, 0x7e814e, 0x7ed91c, 0x7f3127
.pword 0x7f8970, 0x7fe1f5, 0x803ab8, 0x8093b8, 0x80ecf7, 0x814673, 0x81a02d, 0x81fa26
.pword 0x82545d, 0x82aed3, 0x830988, 0x83647b, 0x83bfae, 0x841b20, 0x8476d1, 0x84d2c2
.pword 0x852ef3, 0x858b63, 0x85e814, 0x864506, 0x86a238, 0x86ffaa, 0x875d5e, 0x87bb52
.pword 0x881988, 0x8877ff, 0x88d6b8, 0x8935b1, 0x8994ee, 0x89f46c, 0x8a542d, 0x8ab430
.pword 0x8b1476, 0x8b74fe, 0x8bd5ca, 0x8c36d9, 0x8c982b, 0x8cf9c1, 0x8d5b9a, 0x8dbdb7
.pword 0x8e2019, 0x8e82be, 0x8ee5a8, 0x8f48d7, 0x8fac4b, 0x901004, 0x907401, 0x90d845
.pword 0x913cce, 0x91a19d, 0x9206b2, 0x926c0c, 0x92d1ae, 0x933795, 0x939dc4, 0x940439
.pword 0x946af5, 0x94d1f9, 0x953944, 0x95a0d7, 0x9608b2, 0x9670d5, 0x96d941, 0x9741f4
.pword 0x97aaf1, 0x981435, 0x987dc4, 0x98e79c, 0x9951bc, 0x99bc27, 0x9a26dc, 0x9a91da
.pword 0x9afd24, 0x9b68b7, 0x9bd495, 0x9c40be, 0x9cad32, 0x9d19f1, 0x9d86fc, 0x9df452
.pword 0x9e61f5, 0x9ecfe3, 0x9f3e1e, 0x9faca5, 0xa01b79, 0xa08a99, 0xa0fa08, 0xa169c3
.pword 0xa1d9cc, 0xa24a22, 0xa2bac7, 0xa32bba, 0xa39cfb, 0xa40e8b, 0xa4806a, 0xa4f297
.pword 0xa56514, 0xa5d7e0, 0xa64afc, 0xa6be68, 0xa73224, 0xa7a631, 0xa81a8d, 0xa88f3b
